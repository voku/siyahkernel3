## drivers/clocksource/Kconfig
```kconfig
config CLKSRC_OF
	bool

config CLKSRC_I8253
	bool

config CLKSRC_MMIO
	bool

config ARM_ARCH_TIMER
	bool
	select CLKSRC_OF if OF
```

## drivers/input/keyboard/cypress/Kconfig
```kconfig
#
# Cypress touchkey configuration
#

config KEYBOARD_CYPRESS_GM
	tristate "Cypress touchkey support for GM BLN"
	default y
	select TOUCHKEY_BLN
	---help---
	  Say Y here to enable the cypress touchkey.

config KEYBOARD_CYPRESS_AOKP
        tristate "Cypress touchkey support for AOKP"
	depends on !KEYBOARD_CYPRESS_GM
        ---help---
          Say Y here to enable the cypress touchkey.

config TOUCHKEY_BLN
	bool "BLN Support"
	depends on KEYBOARD_CYPRESS_GM
	---help---
	  BLN support.

config TARGET_CM_KERNEL
	bool "Enable settings for CyanogenMod ROM"
	depends on KEYBOARD_CYPRESS_AOKP
	---help---
	  This option configures BLN that works with
	  CyanogenMod ROM settings and options.
```

## drivers/staging/android/Kconfig
```kconfig
menu "Android"

config ANDROID
	bool "Android Drivers"
	default N
	---help---
	  Enable support for various drivers needed on the Android platform

if ANDROID

config ANDROID_BINDER_IPC
	bool "Android Binder IPC Driver"
	default n

config ANDROID_LOGGER
	tristate "Android log driver"
	default n

config ANDROID_RAM_CONSOLE
	bool "Android RAM buffer console"
	default n

config ANDROID_RAM_CONSOLE_ENABLE_VERBOSE
	bool "Enable verbose console messages on Android RAM console"
	default y
	depends on ANDROID_RAM_CONSOLE

menuconfig ANDROID_RAM_CONSOLE_ERROR_CORRECTION
	bool "Android RAM Console Enable error correction"
	default n
	depends on ANDROID_RAM_CONSOLE
	depends on !ANDROID_RAM_CONSOLE_EARLY_INIT
	select REED_SOLOMON
	select REED_SOLOMON_ENC8
	select REED_SOLOMON_DEC8

if ANDROID_RAM_CONSOLE_ERROR_CORRECTION

config ANDROID_RAM_CONSOLE_ERROR_CORRECTION_DATA_SIZE
	int "Android RAM Console Data data size"
	default 128
	help
	  Must be a power of 2.

config ANDROID_RAM_CONSOLE_ERROR_CORRECTION_ECC_SIZE
	int "Android RAM Console ECC size"
	default 16

config ANDROID_RAM_CONSOLE_ERROR_CORRECTION_SYMBOL_SIZE
	int "Android RAM Console Symbol size"
	default 8

config ANDROID_RAM_CONSOLE_ERROR_CORRECTION_POLYNOMIAL
	hex "Android RAM Console Polynomial"
	default 0x19 if (ANDROID_RAM_CONSOLE_ERROR_CORRECTION_SYMBOL_SIZE = 4)
	default 0x29 if (ANDROID_RAM_CONSOLE_ERROR_CORRECTION_SYMBOL_SIZE = 5)
	default 0x61 if (ANDROID_RAM_CONSOLE_ERROR_CORRECTION_SYMBOL_SIZE = 6)
	default 0x89 if (ANDROID_RAM_CONSOLE_ERROR_CORRECTION_SYMBOL_SIZE = 7)
	default 0x11d if (ANDROID_RAM_CONSOLE_ERROR_CORRECTION_SYMBOL_SIZE = 8)

endif # ANDROID_RAM_CONSOLE_ERROR_CORRECTION

config ANDROID_RAM_CONSOLE_EARLY_INIT
	bool "Start Android RAM console early"
	default n
	depends on ANDROID_RAM_CONSOLE

config ANDROID_RAM_CONSOLE_EARLY_ADDR
	hex "Android RAM console virtual address"
	default 0
	depends on ANDROID_RAM_CONSOLE_EARLY_INIT

config ANDROID_RAM_CONSOLE_EARLY_SIZE
	hex "Android RAM console buffer size"
	default 0
	depends on ANDROID_RAM_CONSOLE_EARLY_INIT

config ANDROID_TIMED_OUTPUT
	bool "Timed output class driver"
	default y

config ANDROID_TIMED_GPIO
	tristate "Android timed gpio driver"
	depends on GENERIC_GPIO && ANDROID_TIMED_OUTPUT
	default n

config ANDROID_LOW_MEMORY_KILLER
	bool "Android Low Memory Killer"
	default y
	---help---
	  Register processes to be killed when memory is low

config ANDROID_LOW_MEMORY_KILLER_AUTODETECT_OOM_ADJ_VALUES
	bool "Android Low Memory Killer: detect oom_adj values"
	depends on ANDROID_LOW_MEMORY_KILLER
	default y
	---help---
	  Detect oom_adj values written to
	  /sys/module/lowmemorykiller/parameters/adj and convert them
	  to oom_score_adj values.

config LMK_SCREEN_STATE
	bool "Activate LMK tuning on screen on/off"
	depends on ANDROID_LOW_MEMORY_KILLER
	default y
	---help---
	  /sys/module/lowmemorykiller/parameters/minfree_screen_off

config KILL_ONCE_IF_SCREEN_OFF
	bool "Kill Apps only once, if the screen is off"
	depends on LMK_SCREEN_STATE
	default y
	---help---
	  debug via: echo "2" > /sys/module/lowmemorykiller/parameters/debug_level;

config LOWMEM_DEATHPENDING_DEPTH
	int "How many apps we kill at the same time"
	default 3
	depends on ENHANCED_LMK_ROUTINE

config ENHANCED_LMK_ROUTINE
	bool "Kill more Apps at the same time"
	default y

config SHRINKER_TARGET_ZONE
	bool "Add lmk parameters tunning code"
	default n

config LMK_APP_PROTECTION
	bool "EXPERIMENTAL: string-compare some apps"
	default n
	---help---
	  Do not kill e.g.: d.process.acore, d.process.media ...

endif # if ANDROID

endmenu
```
